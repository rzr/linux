## Documentation/devicetree/bindings/crypto/sunxi-ss.txt
```
* Allwinner Security System found on A20 SoC

Required properties:
- compatible : Should be "allwinner,sun7i-a20-crypto".
- reg: Should contain the SS register location and length.
- interrupts: Should contain the IRQ line for the SS.
- clocks : A phandle to the functional clock node of the SS module
- clock-names : Name of the functional clock, should be "ahb" and "mod".
```

## Documentation/devicetree/bindings/input/sun4i-lradc-keys.txt
```
Allwinner sun4i low res adc attached tablet keys
------------------------------------------------

Required properties:
 - compatible: "allwinner,sun4i-lradc-keys"
 - reg: mmio address range of the chip
 - interrupts: interrupt to which the chip is connected
 - allwinner,chan0-step: step in mV between keys must be 150 or 200
 - linux,chan0-keycodes: array of dt-bindings/input/input.h KEY_ codes

Example:

#include <dt-bindings/input/input.h>

	lradc: lradc@01c22800 {
		compatible = "allwinner,sun4i-lradc-keys";
		reg = <0x01c22800 0x100>;
		interrupts = <31>;
		allwinner,chan0-step = <200>;
		linux,chan0-keycodes = <KEY_VOLUMEUP KEY_VOLUMEDOWN
					KEY_MENU KEY_ENTER KEY_HOME>;
	};
```

## Documentation/devicetree/bindings/mfd/axp20x.txt
```
AXP202/AXP209 device tree bindings

The axp20x family current members :-
axp202 (X-Powers)
axp209 (X-Powers)

Required properties:
- compatible: "x-powers,axp202" or "x-powers,axp209"
- reg: The I2C slave address for the AXP chip
- interrupt-parent: The parent interrupt controller
- interrupts: Interrupt specifiers for interrupt sources
- interrupt-controller: axp20x has its own internal IRQs
- #interrupt-cells: Should be set to 1
- acin-supply: The input supply for LDO1
- vin2-supply: The input supply for DCDC2
- vin3-supply: The input supply for DCDC3
- ldo24in-supply: The input supply for LDO2, LDO4
- ldo3in-supply: The input supply for LDO3
- ldo5in-supply: The input supply for LDO5

- regulators: A node that houses a sub-node for each regulator. The regulators are
	      bound using their name as listed here: dcdc2, dcdc3, ldo1, ldo2,
	      ldo3, ldo4, ldo5.  The bindings details of individual regulator
	      device can be found in:
	      Documentation/devicetree/bindings/regulator/regulator.txt with
	      the exception of x-powers,dcdc-freq
- x-powers,dcdc-freq: defines the work frequency of DC-DC in KHz
		      (range: 750-1875). Default: 1.5MHz

Optional properties for DCDCs:
- x-powers,dcdc-workmode: 1 for PWM mode, 0 for AUTO mode
			  Default: AUTO mode

Example:

axp209: pmic@34 {
	compatible = "x-powers,axp209";
	reg = <0x34>;
	interrupt-parent = <&nmi_intc>;
	interrupts = <0 8>;

	interrupt-controller;
	#interrupt-cells = <1>;

	acin-supply = <&axp_ipsout_reg>;
	vin2-supply = <&axp_ipsout_reg>;
	vin3-supply = <&axp_ipsout_reg>;
	ldo24in-supply = <&axp_ipsout_reg>;
	ldo3in-supply = <&axp_ipsout_reg>;
	ldo5in-supply = <&axp_ipsout_reg>;

	regulators {
		x-powers,dcdc-freq = <1500>;

		axp_vcore_reg: dcdc2 {
			regulator-min-microvolt = <700000>;
			regulator-max-microvolt = <2275000>;
			regulator-always-on;
		};

		axp_ddr_reg: dcdc3 {
			regulator-min-microvolt = <700000>;
			regulator-max-microvolt = <3500000>;
			regulator-always-on;
		};

		axp_rtc_reg: ldo1 {
			regulator-always-on;
		};

		axp_analog_reg: ldo2 {
			regulator-min-microvolt = <1800000>;
			regulator-max-microvolt = <3300000>;
			regulator-always-on;
		};

		axp_pll_reg: ldo3 {
			regulator-min-microvolt = <700000>;
			regulator-max-microvolt = <3500000>;
		};

		axp_hdmi_reg: ldo4 {
			regulator-min-microvolt = <1250000>;
			regulator-max-microvolt = <3300000>;
		};

		axp_mic_reg: ldo5 {
			regulator-min-microvolt = <1800000>;
			regulator-max-microvolt = <3300000>;
		};
	};
};
```

## Documentation/devicetree/bindings/rfkill/rfkill-gpio.txt
```
GPIO controlled RFKILL devices

Required properties:
- compatible	: Must be "rfkill-gpio".
- rfkill-name	: Name of RFKILL device
- rfkill-type	: Type of RFKILL device: 1 for WiFi, 2 for BlueTooth
- NAME_shutdown-gpios	: GPIO phandle to shutdown control
			  (phandle must be the second)
- NAME_reset-gpios	: GPIO phandle to reset control

NAME must match the rfkill-name property. NAME_shutdown-gpios or
NAME_reset-gpios, or both, must be defined.

Optional properties:
- clocks		: phandle to clock to enable/disable
- clock-frequency	: clock rate to set for the given clock

Example:

	rfkill_bt: rfkill@0 {
		compatible = "rfkill-gpio";
		rfkill-name = "bluetooth";
		rfkill-type = <2>;
		bluetooth_shutdown-gpios = <0>, <&pio 7 18 0>;
		bluetooth_reset-gpios = <&pio 7 24 0>;
		clocks = <&clk_out_a>;
		clock-frequency = <32678>;
	};
```

## Documentation/devicetree/bindings/staging/net/wireless/brcm,bcm43xx-fmac.txt
```
Broadcom BCM43xx Fullmac wireless SDIO devices

This node provides properties for controlling the Broadcom wireless device. The
node is expected to be specified as a child node to the SDIO controller that
connects the device to the system.

Required properties:

 - compatible : Should be "brcm,bcm43xx-fmac".
 - brcm,wlan-supply : phandle for gpio to control power for the device/module.

Optional properties:
 - brcm,wlan-reset : phandle for gpio to reset the device/module.
 - brcm,drive-strength : drive strength used for SDIO pins on device.
	(default = 6mA).
 - interrupt-parent : the phandle for the interrupt controller to which the
	device interrupts are connected.
 - interrupts : specifies attributes for the out-of-band interrupt (host-wake).
	When not specified the device will use in-band SDIO interrupts.
 - interrupt-names : name of the out-of-band interrupt, which must be set
	to "host-wake".
 - clocks : specifies the clocks needed for the device.
	The device requires two clocks which must be named "sysclk"
	and "sleepclk".
 - clock-names : specifies the names of clocks.

Example:

bcm4335 {
	compatible = "brcm,bcm43xx-fmac";
	brcm,wlan-supply = <&wlan-pwr>;
	brcm,wlan-reset = <&wlan-rst>;
	brcm,drive-strength = <4>;
	interrupt-parent = <&gpx2>;
	interrupts = <5 IRQ_TYPE_LEVEL_HIGH>;
	interrupt-names = "host-wake";
	clocks = <&osc 1>, <&osc 2>;
	clock-names = "sysclk", "sleepclk";
};
```

## arch/arm/mach-mv88fxx81/LSP/Kconfig
```kconfig
if ARCH_MV88fxx81

menu "mv88fxx81 Options"
	depends on ARCH_MV88fxx81

choice
	prompt "system type (mv88f1181 / mv88f5181)"
	default ARCH_MV88f1181

config ARCH_MV88f1181
	bool "Support for mv88f1181"
	---help---
	  Choosing this option will generate a linux kernel for the mv88f1181

config ARCH_MV88f5181
	bool "Support for mv88f5181"
	---help---
	  Choosing this option will generate a linux kernel for the mv88f5181

endchoice

config  MV88F5182
        bool "Support for Orion-NAS"
        depends on ARCH_MV88f5181
        ---help---

config  VOIP_RD2
        bool "Support for Orion voip RD2 boards"
        depends on ARCH_MV88f5181
        ---help---
            Choosing this option will generate image for the Viop RD2 board.

config  VOIP_RD2_5181L
        bool "Support for Orion voip RD2 boards with the MV88f5181L chipset"
        depends on VOIP_RD2
        ---help---
            Choosing this option will generate image for the Viop RD2 board with 5181L support.  

config  MV_88W8660
        bool "Support for Shark"
        depends on ARCH_MV88f5181
        ---help---


config ARCH_SUPPORTS_BIG_ENDIAN
	bool
	 default y

config USE_DSP
        bool "use pld/ldrd/strd arm DSP instructions"
          default n

config MV_DMA_COPYUSER
       bool "Support DMA copy_to_user() and copy_from_user"
       depends on (ARCH_MV88f5181) && EXPERIMENTAL
         default n
       help
         Say Y here if you want to use the DMA engine to perform
         copy_to_user() and copy_from_user() functionality.

menu "egiga options"

config  ETH_0_MACADDR
	string "Giga port MAC address"
	depends on ARCH_MV88f5181
	default "000000000051"
	---help---
	  Set the Giga port MAC address.

config  EGIGA_PROC
	bool "egiga proc FS (for mvEgigaTool) (TBD)"
	depends on ARCH_MV88f5181
	---help---
	  Use mvEgigaTool proc FS.

config EGIGA_MULTI_Q 
	bool "Multi Q Support (TBD)"
	depends on ARCH_MV88f5181
	---help---
	  Use Multi Q.

config QUARTER_DECK
	bool "Support for Quarter Deck Switch connected through the giga port"
	depends on ARCH_MV88f5181
	---help---
	  Use the Quarter Deck.

endmenu

config  MV_PHONE
	tristate "Support for Marvell telephony support (VoIP)"
	depends on ARCH_MV88f5181 && PHONE
	---help---
	  Choosing this option will enable you to use the Marvell telephony 
	  support for various VoIP applications. 
	  Note that the kernel Telephony subsystem must be chosen too.

menu "cesa options"
	depends on MV88F5182 || VOIP_RD2_5181L

config  MV_CESA
        bool
        default y

config	MV_CESA_OCF
	bool "Support for Marvell CESA OCF driver"
	depends on MV_CESA && OCF_OCF
	---help---
          Choosing this option will enable you to use the Marvell Cryptographic Engine and
	  Security Accelerator, under the OCF package.

config  MV_CESA_TEST
	bool "Support for Marvell CESA test driver"
	depends on MV_CESA && !MV_CESA_OCF
        ---help---
          Choosing this option will enable you to use the Marvell Cryptographic Engine and
          Security Accelerator, with the mv_cesa_tool in test mode.

endmenu

config  SCSI_MVSATA
	tristate "Support for Marvell Sata Adapters"
	depends on PCI && SCSI
	---help---
	  Choosing this option will enable you to use the Marvell Sata 
	  adapters support with emulation as SCSI adapters. 
	  Note that the kernel scsi subsystem must be chosen too.

config  MV88fxx81_PROC
	bool "Support for MV-shell proc file system"
	depends on PROC_FS
	---help---	
	  Choosing this option will enable you to use the MV-shell through the Proc
	  File system.
	  The MV-shell is a debug utility which can be run from the shell.

config  UBOOT_STRUCT
	bool "Use UBoot Marvell tag structure"
	---help---
	  Choosing this option will cause the linux to extract the Tclk, Sysclk and
	  the uboot version from the Tag list passed by the uboot.

choice
	prompt "usb mode"
	depends on ARCH_MV88f5181 && !UBOOT_STRUCT
	default MV_USB_HOST

config MV_USB_HOST
	bool "Support for usb host"
	---help---
	Choosing this option will configure on chip USB Controller to work in Host mode

config MV_USB_DEVICE
	bool "Support for usb device"
	---help---
	Choosing this option will configure on chip USB Controller to work in Device mode

endchoice

endmenu

endif
```

## drivers/cpufreq/opptimizer/Kconfig
```kconfig
config OPPTIMIZER_KO
	tristate "Opptimizer kernel module"
	depends on OVERCLOCKING
	default m
	help
	  This is the Opptimizer kernel module, which is responsible for
	  adding the user-selected OMAP OPPs to the OPP table.

	  Select m to allow on-the-fly configuration.

config SYMSEARCH_KO
	tristate "Symsearch kernel module"
	depends on OVERCLOCKING
	default m
	help
	  This is the Symsearch kernel module, which patches the routines
	  responsible for OMAP power management to allow Opptimizer to
	  work.

	  Since you're this far, just select m.
```

## drivers/rtc/Kconfig.rej
```kconfig
--- drivers/rtc/Kconfig
+++ drivers/rtc/Kconfig
@@ -333,6 +333,16 @@
 	  This driver can also be built as a module. If so, the module
 	  will be called rtc-twl.
 
+config RTC_DRV_TPS65910
+	tristate "TI TPS65910 RTC driver"
+	depends on RTC_CLASS && MFD_TPS65910
+	help
+	  If you say yes here you get support for the RTC on the
+	  TPS65910 chips.
+
+	  This driver can also be built as a module. If so, the module
+	  will be called rtc-tps65910.
+
 config RTC_DRV_S35390A
 	tristate "Seiko Instruments S-35390A"
 	select BITREVERSE
```
